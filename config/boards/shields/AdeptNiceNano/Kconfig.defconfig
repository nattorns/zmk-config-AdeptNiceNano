## config/boards/shields/AdeptNiceNano/Kconfig.defconfig
```kconfig
if SHIELD_ADEPTNICENANO

config ZMK_KEYBOARD_NAME
    default "AdeptNiceNano"

endif
```

## config/boards/shields/AdeptNiceNano/Kconfig.shield
```kconfig
config SHIELD_ADEPTNICENANO
    def_bool $(shields_list_contains, AdeptNiceNano)
```
